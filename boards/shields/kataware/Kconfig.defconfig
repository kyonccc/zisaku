## boards/shields/kataware/Kconfig.defconfig
```kconfig
# トラックボールを付けた側 = セントラル(PC/スマホとBluetooth接続する側)
# 左右どちらでも、kataware_trackball を一緒に指定した側がセントラルになる
if SHIELD_KATAWARE_TRACKBALL

config ZMK_KEYBOARD_NAME
    default "kataware"

config ZMK_SPLIT_ROLE_CENTRAL
    default y

# トラックボールセンサー(PMW3610)はSPIで通信する
config SPI
    default y

config PMW3610_ALT
    default y

endif

# 左右共通の設定
if SHIELD_KATAWARE_LEFT || SHIELD_KATAWARE_RIGHT

# 分割キーボードとして動作させる
config ZMK_SPLIT
    default y

# マウス機能(マウスボタン・カーソル移動)を有効化
config ZMK_POINTING
    default y

endif
```

## boards/shields/kataware/Kconfig.shield
```kconfig
# どのシールド(キーボード)をビルドしているかを判定するための設定
config SHIELD_KATAWARE_LEFT
    def_bool $(shields_list_contains,kataware_left)

config SHIELD_KATAWARE_RIGHT
    def_bool $(shields_list_contains,kataware_right)

# トラックボール追加用。ボールを付けた側に kataware_left / kataware_right と一緒に指定する
config SHIELD_KATAWARE_TRACKBALL
    def_bool $(shields_list_contains,kataware_trackball)
```

## boards/shields/mykb/Kconfig.defconfig
```kconfig
# 右手側 = セントラル(PCとBluetooth接続する側) + トラックボール搭載
if SHIELD_MYKB_RIGHT

config ZMK_KEYBOARD_NAME
    default "mykb"

config ZMK_SPLIT_ROLE_CENTRAL
    default y

# トラックボールセンサー(PMW3610)はSPIで通信する
config SPI
    default y

config PMW3610_ALT
    default y

endif

# 左右共通の設定
if SHIELD_MYKB_LEFT || SHIELD_MYKB_RIGHT

# 分割キーボードとして動作させる
config ZMK_SPLIT
    default y

# マウス機能(マウスボタン・カーソル移動)を有効化
config ZMK_POINTING
    default y

endif
```

## boards/shields/mykb/Kconfig.shield
```kconfig
# どのシールド(キーボード)をビルドしているかを判定するための設定
config SHIELD_MYKB_LEFT
    def_bool $(shields_list_contains,mykb_left)

config SHIELD_MYKB_RIGHT
    def_bool $(shields_list_contains,mykb_right)
```

## config/west.yml
```yaml
# ビルド時にダウンロードするソースコードの一覧
manifest:
  remotes:
    - name: zmkfirmware
      url-base: https://github.com/zmkfirmware
    - name: badjeff
      url-base: https://github.com/badjeff
  projects:
    # ZMK 本体
    - name: zmk
      remote: zmkfirmware
      revision: main
      import: app/west.yml
    # トラックボールセンサー PMW3610 のドライバ
    - name: zmk-pmw3610-driver
      remote: badjeff
      revision: main
  self:
    path: config
```
