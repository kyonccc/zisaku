/*
 * 左手側 (5列 x 4段 + T・G の内側に2キー + 4段目の内側に2キー + ロータリーエンコーダー)
 */

#include "kataware.dtsi"

&kscan0 {
    col-gpios
        = <&xiao_d 4 GPIO_ACTIVE_HIGH>   // COL0 = D4  (一番外側)
        , <&xiao_d 5 GPIO_ACTIVE_HIGH>   // COL1 = D5
        , <&xiao_d 6 GPIO_ACTIVE_HIGH>   // COL2 = D6
        , <&xiao_d 7 GPIO_ACTIVE_HIGH>   // COL3 = D7
        , <&xiao_d 8 GPIO_ACTIVE_HIGH>   // COL4 = D8
        , <&xiao_d 9 GPIO_ACTIVE_HIGH>   // COL5 = D9  (T・G の右の追加キー、エンコーダー押し込み、英数キー)
        , <&xiao_d 10 GPIO_ACTIVE_HIGH>  // COL6 = D10 (一番内側: 親指の段の追加キーだけ)
        ;
};

// ロータリーエンコーダーを有効化 (左手だけ)
&left_encoder {
    status = "okay";
};
