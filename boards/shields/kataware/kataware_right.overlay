/*
 * 右手側 (5列 x 4段 + Y・H の内側に2キー + 内側にトラックボール)
 * kataware_trackball と一緒にビルドする (ボール付き = PCとつながる側)
 */

#include "kataware.dtsi"

// 右手側はキーマップ上で 7列目から始まる (0〜6列目は左手)
&default_transform {
    col-offset = <7>;
};

&kscan0 {
    col-gpios
        = <&xiao_d 4 GPIO_ACTIVE_HIGH>  // COL7  = D4 (一番内側: Y・H の左の追加キーだけ)
        , <&xiao_d 5 GPIO_ACTIVE_HIGH>  // COL8  = D5 (Y H N の列)
        , <&xiao_d 6 GPIO_ACTIVE_HIGH>  // COL9  = D6
        , <&xiao_d 7 GPIO_ACTIVE_HIGH>  // COL10 = D7
        , <&xiao_d 8 GPIO_ACTIVE_HIGH>  // COL11 = D8
        , <&xiao_d 9 GPIO_ACTIVE_HIGH>  // COL12 = D9 (一番外側)
        ;
};
